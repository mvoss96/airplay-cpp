## CMakeLists.txt
```
cmake_minimum_required(VERSION 3.20)
# airplay-cpp as a Zephyr module (in your west manifest, add the repository as a project instead)
list(APPEND ZEPHYR_EXTRA_MODULES ${CMAKE_CURRENT_SOURCE_DIR}/../..)
find_package(Zephyr REQUIRED HINTS $ENV{ZEPHYR_BASE})
project(airplay_zephyr_example)

target_sources(app PRIVATE src/main.cpp)
```

## prj.conf
```kconfig
CONFIG_CPP=y
CONFIG_STD_CPP17=y
CONFIG_REQUIRES_FULL_LIBCPP=y
CONFIG_AIRPLAY_CPP=y

CONFIG_NETWORKING=y
CONFIG_NET_SOCKETS=y
CONFIG_ZVFS_OPEN_MAX=20
# The receiver polls the open ones of its sockets at once: 3 UDP, 2 PTP, the listener and up to 10 connections
CONFIG_ZVFS_POLL_MAX=16

CONFIG_MAIN_STACK_SIZE=16384
# Jitter buffer (2.5 s, about 460 KB), decoder and AirPlay 2 buffered audio (128 KB), allocated with k_malloc
CONFIG_HEAP_MEM_POOL_SIZE=1572864

# mbedTLS with RSA (PKCS#1 v1.5 and OAEP), PEM keys, AES-CBC and SHA-1
CONFIG_MBEDTLS=y
CONFIG_MBEDTLS_BUILTIN=y
CONFIG_MBEDTLS_ENABLE_HEAP=y
CONFIG_MBEDTLS_HEAP_SIZE=32768
CONFIG_MBEDTLS_KEY_EXCHANGE_RSA_ENABLED=y
CONFIG_MBEDTLS_PEM_CERTIFICATE_FORMAT=y
CONFIG_MBEDTLS_CIPHER_AES_ENABLED=y
CONFIG_MBEDTLS_CIPHER_MODE_CBC_ENABLED=y
CONFIG_MBEDTLS_SHA1=y
CONFIG_MBEDTLS_MD=y
# Also the random bytes for AirPlay 2 pairing (sys_csrand_get)
CONFIG_ENTROPY_GENERATOR=y
```

## boards/native_sim_native_64.conf
```kconfig
# Use the host's sockets: senders on this machine reach the receiver on 127.0.0.1:5000
CONFIG_NET_DRIVERS=y
CONFIG_NET_SOCKETS_OFFLOAD=y
CONFIG_NET_NATIVE_OFFLOADED_SOCKETS=y
```

## src/main.cpp
```c
// AirPlay receiver on Zephyr. The audio goes to a null output that plays in real time and logs how much it
// played; replace it with your board's audio driver.
#include "airplay.h"

#include <zephyr/kernel.h>
#include <zephyr/random/random.h>
#include <zephyr/sys/printk.h>

#include <algorithm>

/// Plays at 44.1 kHz from a 100 ms buffer, discarding the audio
class NullOutput : public airplay::AudioSink {
 public:
  size_t write(const int16_t *, size_t frames) override {
    const uint32_t queued = this->written_ - this->played_;
    const auto accepted =
        static_cast<uint32_t>(std::min<size_t>(frames, CAPACITY_FRAMES - std::min(queued, CAPACITY_FRAMES)));
    this->written_ += accepted;
    return accepted;
  }

  void report_played(airplay::Receiver &receiver) {
    const int64_t now = airplay::SocketRunner::now_us();
    if (this->last_us_ == 0)
      this->last_us_ = now;
    this->clock_ += (now - this->last_us_) * static_cast<int64_t>(airplay::SAMPLE_RATE);
    this->last_us_ = now;
    const auto elapsed = static_cast<uint32_t>(this->clock_ / 1000000);
    this->clock_ -= static_cast<int64_t>(elapsed) * 1000000;
    const uint32_t played = std::min(elapsed, this->written_ - this->played_);
    if (played > 0) {
      this->played_ += played;
      this->total_ += played;
      receiver.notify_played(played, now);
    }
  }

  uint64_t total() const { return this->total_; }

 private:
  static constexpr uint32_t CAPACITY_FRAMES = airplay::SAMPLE_RATE / 10;
  uint32_t written_{0};
  uint32_t played_{0};
  uint64_t total_{0};
  int64_t last_us_{0};
  int64_t clock_{0};
};

class PrintingListener : public airplay::Listener {
 public:
  explicit PrintingListener(NullOutput &output) : output_(output) {}
  void on_session_state(airplay::SessionState state) override {
    static const char *const NAMES[] = {"stopped", "playing", "paused"};
    printk("Session: %s (%u frames played)\n", NAMES[static_cast<int>(state)],
           static_cast<unsigned>(this->output_.total()));
  }
  void on_volume(float volume) override { printk("Volume: %d%%\n", static_cast<int>(volume * 100)); }
  void on_metadata(const airplay::Metadata &metadata) override {
    if (metadata.title[0] != '\0')
      printk("Now playing: %s - %s\n", metadata.artist, metadata.title);
  }

 private:
  NullOutput &output_;
};

static airplay::MbedtlsCrypto crypto;
static NullOutput output;
static PrintingListener listener(output);
static airplay::SocketRunner runner;

int main() {
  airplay::set_log_handler([](airplay::LogLevel, const char *message) { printk("%s\n", message); },
                           airplay::LogLevel::LOG_LEVEL_DEBUG);

  airplay::ReceiverConfig config;
  config.name = "Zephyr Speaker";
  const uint8_t mac[6] = {0x02, 0x00, 0x5e, 0x10, 0x20, 0x30};  // Use the network interface's address
  std::copy(mac, mac + 6, config.mac);
  config.buffer_ms = 2500;
  config.metadata = true;
  // AirPlay 2 with PTP timing, which macOS needs; ports 319 and 320 need root on Linux (native_sim)
  config.airplay2 = true;
  config.ptp = true;
  config.random = [](uint8_t *buffer, size_t length) {
    if (sys_csrand_get(buffer, length) != 0)
      k_panic();
  };
  config.allocate = [](size_t size) { return k_malloc(size); };
  config.deallocate = k_free;

  static airplay::Receiver receiver(config, crypto, runner, output, &listener);
  if (!crypto.init() || !receiver.begin()) {
    printk("Setup failed\n");
    return 1;
  }
  while (!runner.begin(receiver))
    k_sleep(K_SECONDS(1));

  char instance[96];
  receiver.service_instance_name(instance, sizeof(instance));
  printk("AirPlay receiver %s on port %u\n", instance, airplay::Receiver::DEFAULT_PORT);
  while (true) {
    runner.run_once(100);
    output.report_played(receiver);
  }
  return 0;
}
```
