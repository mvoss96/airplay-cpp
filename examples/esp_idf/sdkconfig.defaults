## zephyr/Kconfig
```kconfig
config AIRPLAY_CPP
	bool "airplay-cpp AirPlay 1 receiver"
	depends on CPP
	depends on NETWORKING
	help
	  AirPlay 1 (RAOP) audio receiver. The socket runner needs CONFIG_NET_SOCKETS
	  and CONFIG_ZVFS_POLL_MAX of 6 or more, the mbedTLS backend needs
	  CONFIG_MBEDTLS.
```
